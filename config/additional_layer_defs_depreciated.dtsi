ZMK_LAYER(uc,
//╭──────╮ ╭─────────────┬─────────────┬─────────────┬─────────────┬─────────────╮ ╭──────╮ ╭─────────────┬─────────────┬─────────────┬─────────────┬─────────────╮ ╭──────╮
    X_LT     &el_nu        &el_mu        &el_lambda    &el_chi       &el_pi          X_MT     &el_beta      &el_theta     &el_upsilon   &el_omikron   &el_psi         X_RT
//├──────┤ ├─────────────┼─────────────┼─────────────┼─────────────┼─────────────┤ ├──────┤ ├─────────────┼─────────────┼─────────────┼─────────────┼─────────────┤ ├──────┤
    X_LM     &el_sigma     &el_tau       &el_rho       &el_delta     &el_upsilon     X_MM     &el_phi       &el_nu        &el_epsilon   &el_alpha     &el_iota        X_RM
//├──────┤ ├─────────────┼─────────────┼─────────────┼─────────────┼─────────────┤ ├──────┤ ├─────────────┼─────────────┼─────────────┼─────────────┼─────────────┤ ├──────┤
    X_LB     &el_chi       &el_kappa     &el_xi        &el_gamma     &el_omega       X_MB      &el_zeta      &el_eta       ___           ___           ___            X_RB
//├──────┤ ╰─────────────┼─────────────┴─────────────┼─────────────┼─────────────┤ ├──────┤ ├─────────────┼─────────────┼─────────────┴───────────────────────────╯ ├──────┤
    X_LH                                               ___           ___             X_MH     ___           ___                                                       X_RH
//╰──────╯                                           ╰─────────────┴─────────────╯ ╰──────╯ ╰───────────────────────────╯                                           ╰──────╯
)