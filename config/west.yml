## config/west.yml
```yaml
manifest:
  remotes:
    - name: zmkfirmware
      url-base: https://github.com/zmkfirmware
    - name: urob
      url-base: https://github.com/urob
    - name: YesterdaysLemon
      url-base: https://github.com/YesterdaysLemon

      projects:
    - name: zmk
      remote: YesterdaysLemon
      revision: main
      import: app/west.yml
    - name: zmk-helpers
      remote: urob
      revision: v2
  self:
    path: ../config
```
